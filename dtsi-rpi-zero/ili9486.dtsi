/dts-v1/;
/plugin/;

/*
0-input
1-output
4-Alternative function

my_pins: my_pins {
	brcm,pins = <7>; // GPIO7
	brcm,function = <0>; // Input
	brcm,pull = <2>; // Pull up
};

my_pins: my_pins {
	brcm,pins = <7>; // GPIO7
	brcm,function = <4>; // Alternative function 0 = SPI0 CE1
};
*/

/ {
	compatible = "brcm,bcm2835", "brcm,bcm2836", "brcm,bcm2708", "brcm,bcm2709";

	fragment@0 {
		target = <&gpio>;
		__overlay__ {
			ili9486_pins: pin_out {
			brcm,pins = <4 17 18 27 22 23 24 25 5 6 12 13 19 16 26 20 21 7 8>;
			brcm,function = <1 1 1 1 1 1 1 1 1 1 1 1 1 1 1 1 1 1 1>; /* Output */
			};
		};
	};

	fragment@1 {
		target-path = "/";
		__overlay__ {
			status = "okay";
			ili: ili9486 {
				compatible = "ilitek, ili9486";
				pinctrl-names = "default";
				pinctrl-0 = <&ili9486_pins>;
				db-gpios = 	<&gpio 4 0>, <&gpio 17 0>, <&gpio 18 0>,
						<&gpio 27 0>, <&gpio 22 0>, <&gpio 23 0>,
						<&gpio 24 0>, <&gpio 25 0>, <&gpio 5 0>,
						<&gpio 6 0>, <&gpio 12 0>, <&gpio 13 0>,
						<&gpio 19 0>, <&gpio 16 0>, <&gpio 26 0>,
						<&gpio 20 0>;
				wr-gpios = <&gpio 21 0>;
				rs-gpios = <&gpio 7 0>;
				reset-gpios = <&gpio 8 0>;
				status = "okay";
			};
		};
	};
};
